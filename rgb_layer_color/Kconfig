## rgb_layer_color/Kconfig
```kconfig
if ZMK_RGB_UNDERGLOW

config RGB_UNDERGLOW_LAYER_COLOR
    bool "Set underglow color from the active layer"
    default y
    depends on (!ZMK_SPLIT || (ZMK_SPLIT && ZMK_SPLIT_ROLE_CENTRAL))
    help
      Set the RGB underglow hue (on both halves) from the highest active
      layer, using RGB_UNDERGLOW_LAYER_COLOR_L<n>_HUE. A layer with hue -1
      leaves the color unchanged. Brightness is left as it is.

      Layer state is only known on the central half of a split keyboard,
      so this is unavailable on peripheral builds.

if RGB_UNDERGLOW_LAYER_COLOR

config RGB_UNDERGLOW_LAYER_COLOR_L0_HUE
    int "Hue (0-359) to use while layer 0 is active, -1 to leave unchanged"
    range -1 359
    default -1

config RGB_UNDERGLOW_LAYER_COLOR_L1_HUE
    int "Hue (0-359) to use while layer 1 is active, -1 to leave unchanged"
    range -1 359
    default -1

config RGB_UNDERGLOW_LAYER_COLOR_L2_HUE
    int "Hue (0-359) to use while layer 2 is active, -1 to leave unchanged"
    range -1 359
    default -1

config RGB_UNDERGLOW_LAYER_COLOR_L3_HUE
    int "Hue (0-359) to use while layer 3 is active, -1 to leave unchanged"
    range -1 359
    default -1

config RGB_UNDERGLOW_LAYER_COLOR_L4_HUE
    int "Hue (0-359) to use while layer 4 is active, -1 to leave unchanged"
    range -1 359
    default -1

config RGB_UNDERGLOW_LAYER_COLOR_L5_HUE
    int "Hue (0-359) to use while layer 5 is active, -1 to leave unchanged"
    range -1 359
    default -1

config RGB_UNDERGLOW_LAYER_COLOR_SAT
    int "Saturation (0-100) to use for the layer colors"
    range 0 100
    default 100

endif # RGB_UNDERGLOW_LAYER_COLOR

config RGB_BT_PROFILE_INDICATOR
    bool "Show the active Bluetooth profile on a per-key LED"
    default y
    depends on DT_HAS_GPMONTT_LED_STRIP_INDICATOR_ENABLED
    help
      Enables the gpmontt,led-strip-indicator pass-through strip. On the
      central half it lights the LED for the active BT profile
      (RGB_BT_PROFILE_INDICATOR_LED_<n>) white: solid while that profile's
      host is connected, blinking while it isn't. On a peripheral half it
      just passes the underglow through unchanged.

if RGB_BT_PROFILE_INDICATOR

config RGB_BT_PROFILE_INDICATOR_LED_0
    int "LED chain index to light for BT profile 0, -1 for none"
    range -1 255
    default -1

config RGB_BT_PROFILE_INDICATOR_LED_1
    int "LED chain index to light for BT profile 1, -1 for none"
    range -1 255
    default -1

config RGB_BT_PROFILE_INDICATOR_LED_2
    int "LED chain index to light for BT profile 2, -1 for none"
    range -1 255
    default -1

config RGB_BT_PROFILE_INDICATOR_BLINK_TIMEOUT_S
    int "Seconds to blink while the active profile is not connected, 0 = forever"
    range 0 3600
    default 60
    help
      ZMK keeps advertising until a host connects and reports no pairing
      failures, so the blink is time-limited instead. After this many
      seconds without a connection the profile LED goes back to the
      underglow (layer) color. The timer restarts when the active profile
      changes or its host connects/disconnects.

config RGB_BT_PROFILE_INDICATOR_FINDER
    bool "LED finder mode"
    help
      Instead of the normal underglow, light one LED at a time (2 seconds
      each) and log its chain index, to find which index sits under which
      key. Needs underglow on; read the log over USB (CONFIG_ZMK_USB_LOGGING).

endif # RGB_BT_PROFILE_INDICATOR

endif # ZMK_RGB_UNDERGLOW
```

## rgb_layer_color/dts/bindings/led/gpmontt,led-strip-indicator.yaml
```yaml
description: |
  Pass-through LED strip that forwards every update to a real strip,
  overriding a few pixels to show the active Bluetooth profile. Point
  the zmk,underglow chosen node at this instead of the real strip.

compatible: "gpmontt,led-strip-indicator"

properties:
  led-strip:
    type: phandle
    required: true
    description: The real LED strip to forward updates to.

  chain-length:
    type: int
    required: true
    description: Number of pixels; must match the real strip's chain-length.
```
